## CMakeLists.txt
```
cmake_minimum_required(VERSION 3.20.0)
find_package(Zephyr REQUIRED HINTS $ENV{ZEPHYR_BASE})
project(l2_task1 LANGUAGES C)
target_sources(app PRIVATE src/main.c)
```

## prj.conf
```kconfig
CONFIG_SERIAL=y
CONFIG_CONSOLE=y
CONFIG_UART_CONSOLE=y
# Enable the GPIO framework and tracking system drivers
CONFIG_GPIO=y
```

## app.overlay
```dts
/ {
    aliases {
        external-led = &ext_led_node;
    };

    leds {
        compatible = "gpio-leds";
        ext_led_node: led_gpio_15 {
            gpios = <&gpio0 15 GPIO_ACTIVE_HIGH>;
            label = "External Breadboard LED";
        };
    };
};
```

## src/main.c
```c
#include <zephyr/kernel.h>
#include <zephyr/drivers/gpio.h>
#include <zephyr/sys/printk.h>

// Fetch the clean structural overlay mapping for your breadboard GP15 circuit loop
static const struct gpio_dt_spec led = GPIO_DT_SPEC_GET(DT_ALIAS(external_led), gpios);

int main(void)
{
    k_msleep(1000);
    printk("*** Booting Zephyr External LED Firmware ***\n");

    if (!gpio_is_ready_dt(&led)) {
        printk("Error: GPIO port device framework is not ready!\n");
        return 0;
    }

    // Configure the pin structure with native active voltage layout properties
    gpio_pin_configure_dt(&led, GPIO_OUTPUT_ACTIVE);

    while (1) {
        gpio_pin_toggle_dt(&led);
        printk("LED Pin 15 Toggled!\n");
        k_msleep(1000); // Sleep cleanly for 1 second (1000ms)
    }

    return 0;
}
```
